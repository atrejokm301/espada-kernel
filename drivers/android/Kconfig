## drivers/android/Kconfig
```kconfig
# SPDX-License-Identifier: GPL-2.0
menu "Android"

config ANDROID_BINDER_IPC
	bool "Android Binder IPC Driver"
	depends on MMU
	depends on NET
	default n
	help
	  Binder is used in Android for both communication between processes,
	  and remote method invocation.

	  This means one Android process can call a method/routine in another
	  Android process, using Binder to identify, invoke and pass arguments
	  between said processes.

config ANDROID_BINDERFS
	bool "Android Binderfs filesystem"
	depends on ANDROID_BINDER_IPC
	default n
	help
	  Binderfs is a pseudo-filesystem for the Android Binder IPC driver
	  which can be mounted per-ipc namespace allowing to run multiple
	  instances of Android.
	  Each binderfs mount initially only contains a binder-control device.
	  It can be used to dynamically allocate new binder IPC devices via
	  ioctls.

config ANDROID_BINDER_DEVICES
	string "Android Binder devices"
	depends on ANDROID_BINDER_IPC || ANDROID_BINDER_IPC_RUST
	default "binder,hwbinder,vndbinder"
	help
	  Default value for the binder.devices parameter.

	  The binder.devices parameter is a comma-separated list of strings
	  that specifies the names of the binder device nodes that will be
	  created. Each binder device has its own context manager, and is
	  therefore logically separated from the other devices.

source "drivers/android/binder/Kconfig"

config ANDROID_BINDER_IPC_SELFTEST
	bool "Android Binder IPC Driver Selftest"
	depends on ANDROID_BINDER_IPC
	help
	  This feature allows binder selftest to run.

	  Binder selftest checks the allocation and free of binder buffers
	  exhaustively with combinations of various buffer sizes and
	  alignments.

config ANDROID_VENDOR_HOOKS
	bool "Android Vendor Hooks"
	depends on TRACEPOINTS
	help
	  Enable vendor hooks implemented as tracepoints

	  Allow vendor modules to attach to tracepoint "hooks" defined via
	  DECLARE_HOOK or DECLARE_RESTRICTED_HOOK.

config ANDROID_DEBUG_KINFO
	bool "Android Debug Kernel Information Support"
	depends on KALLSYMS
	help
	  This supports kernel information backup for bootloader usage.
	  Specifics:
	   - The kallsyms symbols for unwind_backtrace
	   - Page directory pointer
	   - UTS_RELEASE
	   - BUILD_INFO(ro.build.fingerprint)

config ANDROID_KABI_RESERVE
	bool "Android KABI reserve padding"
	default y
	help
	  This option enables the padding that the Android GKI kernel adds
	  to many different kernel structures to support an in-kernel stable ABI
	  over the lifespan of support for the kernel.

	  Only disable this option if you have a system that needs the Android
	  kernel drivers, but is NOT an Android GKI kernel image. If disabled
	  it has the possibility to make the kernel static and runtime image
	  slightly smaller but will NOT be supported by the Google Android
	  kernel team.

	  If even slightly unsure, say Y.

config ANDROID_VENDOR_OEM_DATA
	bool "Android vendor and OEM data padding"
	default y
	help
	  This option enables the padding that the Android GKI kernel adds
	  to many different kernel structures to support an in-kernel stable ABI
	  over the lifespan of support for the kernel as well as OEM additional
	  fields that are needed by some of the Android kernel tracepoints. The
	  macros enabled by this option are used to enable padding in vendor modules
	  used for the above specified purposes.

	  Only disable this option if you have a system that needs the Android
	  kernel drivers, but is NOT an Android GKI kernel image and you do NOT
	  use the Android kernel tracepoints. If disabled it has the possibility
	  to make the kernel static and runtime image slightly smaller but will
	  NOT be supported by the Google Android kernel team.

	  If even slightly unsure, say Y.

config ANDROID_WRAPFD
	bool "WrapFD Driver"
	depends on MMU
	help
	  Enable WrapFD driver to control ability to map a file

	  WrapFD allows wrapping an fd representing a memory buffer into a new
	  file supporting ioctl API for file ownership that controls ability to
	  map the file.

config ANDROID_SIMPLE_LMK
	bool "Simple Android Low Memory Killer"
	depends on !ANDROID_LOW_MEMORY_KILLER
	help
	  This is a complete low memory killer solution for Android that is
	  small and simple. Processes are killed according to the priorities
	  that Android gives them, so that the least important processes are
	  always killed first. Processes are killed until memory deficits are
	  satisfied, as observed from kswapd struggling to free up pages, via
	  VM pressure notifications. (ES301 port of Sultan's Simple LMK; the
	  upstream !MEMCG/!PSI dependency is dropped so it coexists with lmkd.)

if ANDROID_SIMPLE_LMK

config ANDROID_SIMPLE_LMK_MINFREE
	int "Minimum MiB of memory to free per reclaim"
	range 8 512
	default 128
	help
	  Simple LMK will try to free at least this much memory per reclaim.

config ANDROID_SIMPLE_LMK_TIMEOUT_MSEC
	int "Reclaim timeout in milliseconds"
	range 50 1000
	default 200
	help
	  Simple LMK tries to wait until all of the victims it kills have
	  their memory reclaimed. Since some victims can take a while to die,
	  Simple LMK will give up after this many milliseconds.

endif

endmenu
```
